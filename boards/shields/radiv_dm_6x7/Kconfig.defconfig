## boards/shields/radiv_dm_6x7/Kconfig.defconfig
```kconfig
if SHIELD_RADIV_DM_6X7_LEFT

    config ZMK_KEYBOARD_NAME
        default "Radiv DM"

    config ZMK_SPLIT_BLE_ROLE_CENTRAL
        default y

    config ZMK_SPLIT
        default y

endif

if SHIELD_RADIV_DM_6X7_RIGHT

    config ZMK_SPLIT
        default y

endif
```

## boards/shields/radiv_dm_6x7/Kconfig.shield
```kconfig
config SHIELD_RADIV_DM_6X7_LEFT
    def_bool $(shields_list_contains,radiv_dm_6x7_left)

config SHIELD_RADIV_DM_6X7_RIGHT
    def_bool $(shields_list_contains,radiv_dm_6x7_right)
```
